
#include <Adafruit_GFX.h>
#include <Adafruit_SSD1306.h>
#include <OneButton.h>
#include <ESP32Time.h>
#include <WiFi.h>
#include <WiFiUdp.h>
#include <NTPClient.h> 
#include <TimeLib.h> 
#include <Fonts/Org_01.h>
#include "arduinoFFT.h"
#include <Arduino.h>

arduinoFFT FFT;

#define SCREEN_WIDTH 128
#define SCREEN_HEIGHT 64

#define OLED_RESET    -1 // Reset pin tidak digunakan
#define SCREEN_ADDRESS 0x3C // Alamat I2C layar OLED

//OlED Setup
Adafruit_SSD1306 display(SCREEN_WIDTH, SCREEN_HEIGHT, &Wire, OLED_RESET);

//Button Setup
OneButton btn(12, true);
OneButton btn2(13, true);

//RTC DateFinder
ESP32Time rtc(25200); //GMT+7

//NTP setup
const char *ssid     = "1421URG";
const char *password = "NasiPadangAja";

WiFiUDP ntpUDP;
NTPClient timeClient(ntpUDP);

//MainMenu

int selectP = 1;
int stateUp;
int stateDown;
int last_second;

String onPage = "menu";

//DateFinder 
int dayFind = 0;
int monthFind = 0;
int yearFind = 2023;
int onsetup = 1;

//Spectrum setup
const uint16_t samples = 128;
const double sampling = 10000;

double vReal[samples];
double vImag[samples];

//SEMAPHORE

// 'Semapur25', 48x48px
const unsigned char myBitmapSemapur25 [] PROGMEM = {
	0xff, 0xff, 0xff, 0xff, 0xff, 0xff, 0xff, 0xff, 0xff, 0xff, 0xff, 0xff, 0xff, 0xff, 0xff, 0xff, 
	0xff, 0xff, 0xff, 0xff, 0xff, 0xff, 0xff, 0xff, 0xfc, 0x7f, 0xff, 0xff, 0xff, 0xff, 0xfc, 0x3f, 
	0xff, 0xff, 0xff, 0xff, 0xf8, 0x1f, 0xff, 0xff, 0xff, 0xff, 0xf0, 0x0f, 0xff, 0xff, 0xff, 0xff, 
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	0xff, 0xff, 0xff, 0xff, 0xff, 0xff, 0xff, 0xff, 0xff, 0xff, 0xff, 0xff, 0xff, 0xff, 0xff, 0xff
};
// 'Semapur26', 48x48px
const unsigned char myBitmapSemapur26 [] PROGMEM = {
	0xff, 0xff, 0xff, 0xff, 0xff, 0xff, 0xff, 0xff, 0xff, 0xff, 0xff, 0xff, 0xff, 0xff, 0xff, 0xff, 
	0xff, 0xff, 0xff, 0xff, 0xff, 0xff, 0xff, 0xff, 0xff, 0xff, 0xff, 0xff, 0xff, 0xff, 0xff, 0xff, 
	0xff, 0xff, 0xff, 0xff, 0xff, 0xff, 0xff, 0xff, 0xff, 0xff, 0xff, 0xff, 0xff, 0xff, 0xff, 0xff, 
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	0xff, 0xff, 0xff, 0xff, 0xff, 0xff, 0xff, 0xff, 0xff, 0xff, 0xff, 0xff, 0xff, 0xff, 0xff, 0xff
};
// 'Semapur24', 48x48px
const unsigned char myBitmapSemapur24 [] PROGMEM = {
	0xff, 0xff, 0xff, 0xff, 0xff, 0xff, 0xff, 0xff, 0xff, 0xff, 0xff, 0xff, 0xff, 0xff, 0xff, 0xff, 
	0xff, 0xff, 0xff, 0xff, 0xff, 0xff, 0xff, 0xff, 0xff, 0xff, 0xff, 0xff, 0xfe, 0xff, 0xff, 0xff, 
	0xff, 0xff, 0xfc, 0x3f, 0xff, 0xff, 0xff, 0xff, 0xf8, 0x1f, 0xff, 0xff, 0xff, 0xff, 0xf0, 0x1f, 
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	0xff, 0xff, 0xff, 0xff, 0xff, 0xff, 0xff, 0xff, 0xff, 0xff, 0xff, 0xff, 0xff, 0xff, 0xff, 0xff
};
// 'Semapur21', 48x48px
const unsigned char myBitmapSemapur21 [] PROGMEM = {
	0xff, 0xff, 0xff, 0xff, 0xff, 0xff, 0xff, 0xff, 0xff, 0xff, 0xff, 0xff, 0xff, 0xff, 0xff, 0xff, 
	0xff, 0xff, 0xff, 0xff, 0xff, 0xff, 0xff, 0xff, 0xff, 0xff, 0xff, 0xff, 0xff, 0xff, 0xfc, 0xff, 
	0xff, 0xff, 0xfc, 0xff, 0xf8, 0x7f, 0xff, 0xff, 0xf0, 0x7f, 0xf0, 0x3f, 0xff, 0xff, 0xe0, 0x3f, 
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	0xff, 0xff, 0xff, 0xff, 0xff, 0xff, 0xff, 0xff, 0xff, 0xff, 0xff, 0xff, 0xff, 0xff, 0xff, 0xff
};
// 'Semapur19', 48x48px
const unsigned char myBitmapSemapur19 [] PROGMEM = {
	0xff, 0xff, 0xff, 0xff, 0xff, 0xff, 0xff, 0xff, 0xff, 0xff, 0xff, 0xff, 0xff, 0xff, 0xff, 0xff, 
	0xff, 0xff, 0xff, 0xff, 0xff, 0xff, 0xff, 0xff, 0xff, 0xff, 0xff, 0xff, 0xff, 0xff, 0xff, 0xff, 
	0xff, 0xff, 0xff, 0xff, 0xff, 0xff, 0xff, 0xff, 0xff, 0xff, 0xff, 0xff, 0xff, 0xff, 0xff, 0xff, 
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	0xff, 0xff, 0xff, 0xff, 0xff, 0xff, 0xff, 0xff, 0xff, 0xff, 0xff, 0xff, 0xff, 0xff, 0xff, 0xff
};
// 'Semapur23', 48x48px
const unsigned char myBitmapSemapur23 [] PROGMEM = {
	0xff, 0xff, 0xff, 0xff, 0xff, 0xff, 0xff, 0xff, 0xff, 0xff, 0xff, 0xff, 0xff, 0xff, 0xff, 0xff, 
	0xff, 0xff, 0xff, 0xff, 0xff, 0xff, 0xff, 0xff, 0xff, 0xff, 0xff, 0xff, 0xff, 0x3f, 0xff, 0xff, 
	0xff, 0xff, 0xfc, 0x1f, 0xff, 0xff, 0xff, 0xff, 0xf8, 0x0f, 0xff, 0xff, 0xff, 0xff, 0xf0, 0x07, 
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	0xff, 0xff, 0xff, 0xff, 0xff, 0xff, 0xff, 0xff, 0xff, 0xff, 0xff, 0xff, 0xff, 0xff, 0xff, 0xff
};
// 'Semapur18', 48x48px
const unsigned char myBitmapSemapur18 [] PROGMEM = {
	0xff, 0xff, 0xff, 0xff, 0xff, 0xff, 0xff, 0xff, 0xff, 0xff, 0xff, 0xff, 0xff, 0xff, 0xff, 0xff, 
	0xff, 0xff, 0xff, 0xff, 0xff, 0xff, 0xff, 0xff, 0xff, 0xff, 0xff, 0xff, 0xff, 0xff, 0xff, 0xff, 
	0xff, 0xff, 0xff, 0xff, 0xff, 0xff, 0xff, 0xff, 0xff, 0xff, 0xff, 0xff, 0xff, 0xff, 0xff, 0xff, 
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	0xff, 0xff, 0xff, 0xff, 0xff, 0xff, 0xff, 0xff, 0xff, 0xff, 0xff, 0xff, 0xff, 0xff, 0xff, 0xff
};
// 'Semapur20', 48x48px
const unsigned char myBitmapSemapur20 [] PROGMEM = {
	0xff, 0xff, 0xff, 0xff, 0xff, 0xff, 0xff, 0xff, 0xff, 0xe0, 0x7f, 0xff, 0xff, 0xff, 0xff, 0xe0, 
	0x3f, 0xff, 0xff, 0xff, 0xff, 0xe0, 0x3f, 0xff, 0xff, 0xff, 0xff, 0xe0, 0x3f, 0xff, 0xff, 0xff, 
	0xff, 0xe0, 0x3f, 0xff, 0xff, 0xff, 0xff, 0xe0, 0x7f, 0xff, 0xff, 0x7f, 0xff, 0xe4, 0x7f, 0xff, 
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	0xff, 0xff, 0xff, 0xff, 0xff, 0xff, 0xff, 0xff, 0xff, 0xff, 0xff, 0xff, 0xff, 0xff, 0xff, 0xff
};
// 'Semapur22', 48x48px
const unsigned char myBitmapSemapur22 [] PROGMEM = {
	0xff, 0xff, 0xff, 0xff, 0xff, 0xff, 0xff, 0xff, 0xff, 0xff, 0xff, 0xff, 0xff, 0xff, 0xfc, 0x0f, 
	0xff, 0xff, 0xff, 0xff, 0xfc, 0x0f, 0xff, 0xff, 0xff, 0xff, 0xfc, 0x0f, 0xff, 0xff, 0xff, 0xff, 
	0xfc, 0x0f, 0xff, 0xff, 0xff, 0xff, 0xfc, 0x0f, 0xff, 0xff, 0xff, 0xff, 0xfc, 0x0f, 0xff, 0xff, 
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	0xff, 0xdf, 0xff, 0xff, 0xff, 0xff, 0xff, 0xff, 0xff, 0xff, 0xff, 0xff, 0xff, 0xff, 0xff, 0xff
};
// 'Semapur17', 48x48px
const unsigned char myBitmapSemapur17 [] PROGMEM = {
	0xff, 0xff, 0xff, 0xff, 0xff, 0xff, 0xff, 0xff, 0xff, 0xff, 0xff, 0xff, 0xff, 0xff, 0xff, 0xff, 
	0xff, 0xff, 0xff, 0xff, 0xff, 0xff, 0xff, 0xff, 0xff, 0xff, 0xff, 0xff, 0xff, 0xff, 0xff, 0xff, 
	0xff, 0xff, 0xff, 0xff, 0xff, 0xff, 0xff, 0xff, 0xff, 0x9f, 0xff, 0xff, 0xff, 0xff, 0xfe, 0x0f, 
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	0xff, 0xff, 0xff, 0xff, 0xff, 0xff, 0xff, 0xff, 0xff, 0xff, 0xff, 0xff, 0xff, 0xff, 0xff, 0xff
};
// 'Semapur16', 48x48px
const unsigned char myBitmapSemapur16 [] PROGMEM = {
	0xff, 0xff, 0xff, 0xc0, 0xff, 0xff, 0xff, 0xff, 0xff, 0xc0, 0xff, 0xff, 0xff, 0xff, 0xff, 0xc0, 
	0xff, 0xff, 0xff, 0xff, 0xff, 0xc0, 0xff, 0xff, 0xff, 0xff, 0xff, 0xc0, 0xff, 0xff, 0xff, 0xff, 
	0xff, 0xc0, 0xff, 0xff, 0xff, 0xff, 0xff, 0xc0, 0xff, 0xff, 0xff, 0xff, 0xff, 0xdb, 0xff, 0xff, 
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	0xff, 0xff, 0xff, 0xff, 0xff, 0xff, 0xff, 0xff, 0xff, 0xff, 0xff, 0xff, 0xff, 0xff, 0xff, 0xff
};
// 'Semapur11', 48x48px
const unsigned char myBitmapSemapur11 [] PROGMEM = {
	0xff, 0xff, 0xff, 0xff, 0xff, 0xff, 0xff, 0xff, 0xff, 0x01, 0xff, 0xff, 0xff, 0xff, 0xff, 0x01, 
	0xff, 0xff, 0xff, 0xff, 0xff, 0x01, 0xff, 0xff, 0xff, 0xff, 0xff, 0x11, 0xff, 0xff, 0xff, 0xff, 
	0xff, 0x01, 0xff, 0xff, 0xff, 0xff, 0xff, 0x01, 0xff, 0xff, 0xff, 0xff, 0xff, 0x07, 0xff, 0xff, 
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	0xf8, 0x3f, 0xff, 0xff, 0xff, 0xff, 0xff, 0xff, 0xff, 0xff, 0xff, 0xff, 0xff, 0xff, 0xff, 0xff
};
// 'Semapur15', 48x48px
const unsigned char myBitmapSemapur15 [] PROGMEM = {
	0xff, 0xff, 0xff, 0xff, 0xff, 0xff, 0xff, 0xff, 0xff, 0xff, 0xff, 0xff, 0xff, 0xff, 0xff, 0xff, 
	0xff, 0xff, 0xff, 0xff, 0xff, 0xff, 0xff, 0xff, 0xff, 0xff, 0xff, 0xff, 0xff, 0xff, 0xff, 0xff, 
	0xff, 0xff, 0xff, 0xff, 0xff, 0xff, 0xff, 0xff, 0xff, 0xff, 0xff, 0x3f, 0xff, 0xff, 0xff, 0xff, 
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	0xff, 0xff, 0xff, 0xff, 0xff, 0xff, 0xff, 0xff, 0xff, 0xff, 0xff, 0xff, 0xff, 0xff, 0xff, 0xff
};
// 'Semapur14', 48x48px
const unsigned char myBitmapSemapur14 [] PROGMEM = {
	0xff, 0xff, 0xff, 0xff, 0xff, 0xff, 0xff, 0xff, 0xff, 0xff, 0xff, 0xff, 0xff, 0xff, 0xff, 0xff, 
	0xff, 0xff, 0xff, 0xff, 0xff, 0xff, 0xff, 0xff, 0xff, 0xff, 0xff, 0xff, 0xff, 0xff, 0xff, 0xff, 
	0xff, 0x7f, 0xff, 0xff, 0xff, 0xff, 0xfc, 0x1f, 0xff, 0xff, 0xff, 0xff, 0xfc, 0x1f, 0xff, 0xff, 
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	0xff, 0xff, 0xff, 0xff, 0xff, 0xff, 0xff, 0xff, 0xff, 0xff, 0xff, 0xff, 0xff, 0xff, 0xff, 0xff
};
// 'Semapur12', 48x48px
const unsigned char myBitmapSemapur12 [] PROGMEM = {
	0xff, 0xff, 0xff, 0xff, 0xff, 0xff, 0xff, 0xff, 0xff, 0xff, 0xff, 0xff, 0xff, 0xff, 0xff, 0xff, 
	0xff, 0xbf, 0xff, 0xff, 0xff, 0xff, 0xff, 0x1f, 0xff, 0xff, 0xff, 0xff, 0xfe, 0x0f, 0xff, 0xff, 
	0xff, 0xff, 0xfc, 0x07, 0xff, 0xff, 0xff, 0xff, 0xf8, 0x43, 0xff, 0xff, 0xff, 0xff, 0xe0, 0x07, 
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	0xff, 0xff, 0xff, 0xff, 0xff, 0xff, 0xff, 0xff, 0xff, 0xff, 0xff, 0xff, 0xff, 0xff, 0xff, 0xff
};
// 'Semapur10', 48x48px
const unsigned char myBitmapSemapur10 [] PROGMEM = {
	0xff, 0xff, 0xff, 0xff, 0xff, 0xff, 0xff, 0xff, 0xff, 0xff, 0xff, 0xff, 0xff, 0xff, 0xf0, 0x1f, 
	0xff, 0xff, 0xff, 0xff, 0xf0, 0x1f, 0xff, 0xff, 0xff, 0xff, 0xf0, 0x1f, 0xff, 0xff, 0xff, 0xff, 
	0xf0, 0x1f, 0xff, 0xff, 0xff, 0xff, 0xf0, 0x1f, 0xff, 0xff, 0xff, 0xff, 0xf0, 0x1f, 0xff, 0xff, 
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	0xc0, 0x07, 0xff, 0xff, 0xff, 0xff, 0xf8, 0x7f, 0xff, 0xff, 0xff, 0xff, 0xff, 0xff, 0xff, 0xff
};
// 'Semapur13', 48x48px
const unsigned char myBitmapSemapur13 [] PROGMEM = {
	0xff, 0xff, 0xff, 0xff, 0xff, 0xff, 0xff, 0xff, 0xff, 0xff, 0xff, 0xff, 0xff, 0xff, 0xff, 0xff, 
	0xff, 0xff, 0xff, 0xff, 0xff, 0xff, 0xff, 0xff, 0xff, 0xff, 0xff, 0xff, 0xff, 0xff, 0xff, 0xff, 
	0xff, 0xff, 0xff, 0xff, 0xff, 0xff, 0xff, 0xff, 0xff, 0xff, 0xff, 0xff, 0xff, 0xff, 0xff, 0xff, 
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	0xff, 0xff, 0xff, 0xff, 0xff, 0xff, 0xff, 0xff, 0xff, 0xff, 0xff, 0xff, 0xff, 0xff, 0xff, 0xff
};
// 'Semapur9', 48x48px
const unsigned char myBitmapSemapur9 [] PROGMEM = {
	0xff, 0xff, 0xff, 0xff, 0xff, 0xff, 0xff, 0xff, 0xff, 0xff, 0xff, 0xff, 0xff, 0xbf, 0xff, 0xff, 
	0xff, 0xff, 0xff, 0x1f, 0xff, 0xff, 0xff, 0xff, 0xfc, 0x1f, 0xff, 0xff, 0xff, 0xff, 0xf8, 0x0f, 
	0xff, 0xff, 0xff, 0xff, 0xf0, 0x07, 0xff, 0xff, 0xff, 0xff, 0xf8, 0x03, 0xff, 0xff, 0xff, 0xff, 
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	0xff, 0xff, 0xff, 0xff, 0xff, 0xff, 0xff, 0xff, 0xff, 0xff, 0xff, 0xff, 0xff, 0xff, 0xff, 0xff
};
// 'Semapur5', 48x48px
const unsigned char myBitmapSemapur5 [] PROGMEM = {
	0xff, 0xff, 0xff, 0xff, 0xff, 0xff, 0xff, 0xff, 0xff, 0xff, 0xff, 0xff, 0xff, 0xff, 0xff, 0xff, 
	0xff, 0xff, 0xff, 0xff, 0xff, 0xff, 0xff, 0xff, 0xff, 0xff, 0xff, 0xff, 0xff, 0xff, 0xff, 0xff, 
	0xff, 0xff, 0xfc, 0xff, 0xff, 0xff, 0xff, 0xff, 0xf8, 0x7f, 0xff, 0xff, 0xff, 0xff, 0xe0, 0x3f, 
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	0xff, 0xff, 0xff, 0xff, 0xff, 0xff, 0xff, 0xff, 0xff, 0xff, 0xff, 0xff, 0xff, 0xff, 0xff, 0xff
};
// 'Semapur8', 48x48px
const unsigned char myBitmapSemapur8 [] PROGMEM = {
	0xff, 0xff, 0xff, 0xff, 0xff, 0xff, 0xff, 0xff, 0xff, 0xff, 0xff, 0xff, 0xff, 0xff, 0xff, 0xff, 
	0xff, 0xff, 0xff, 0xff, 0xff, 0xff, 0xff, 0xff, 0xff, 0xff, 0xff, 0xff, 0xff, 0xff, 0xff, 0xff, 
	0xff, 0xff, 0xff, 0xff, 0xff, 0xff, 0xff, 0xff, 0xff, 0xff, 0xff, 0xff, 0xff, 0xff, 0xff, 0xff, 
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	0xff, 0xff, 0xff, 0xff, 0xff, 0xff, 0xff, 0xff, 0xff, 0xff, 0xff, 0xff, 0xff, 0xff, 0xff, 0xff
};
// 'Semapur6', 48x48px
const unsigned char myBitmapSemapur6 [] PROGMEM = {
	0xff, 0xff, 0xff, 0xff, 0xff, 0xff, 0xff, 0xff, 0xff, 0xff, 0xff, 0xff, 0xff, 0xff, 0xff, 0xff, 
	0xff, 0xff, 0xff, 0xff, 0xff, 0xff, 0xff, 0xff, 0xff, 0xff, 0xff, 0xff, 0xff, 0xff, 0xff, 0xff, 
	0xff, 0xff, 0xff, 0xff, 0xff, 0xff, 0xff, 0xff, 0xff, 0xff, 0xff, 0xff, 0xff, 0xff, 0xff, 0xff, 
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	0xff, 0xff, 0xff, 0xff, 0xff, 0xff, 0xff, 0xff, 0xff, 0xff, 0xff, 0xff, 0xff, 0xff, 0xff, 0xff
};
// 'Semapur7', 48x48px
const unsigned char myBitmapSemapur7 [] PROGMEM = {
	0xff, 0xff, 0xff, 0xff, 0xff, 0xff, 0xff, 0xff, 0xff, 0xff, 0xff, 0xff, 0xff, 0xff, 0xff, 0xff, 
	0xff, 0xff, 0xff, 0xff, 0xff, 0xff, 0xff, 0xff, 0xff, 0xff, 0xff, 0xff, 0xff, 0xff, 0xff, 0xff, 
	0xff, 0xff, 0xff, 0xff, 0xff, 0xff, 0xf9, 0xff, 0xff, 0xff, 0xff, 0xff, 0xf0, 0x7f, 0xff, 0xff, 
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	0xff, 0xff, 0xff, 0xff, 0xff, 0xff, 0xff, 0xff, 0xff, 0xff, 0xff, 0xff, 0xff, 0xff, 0xff, 0xff
};
// 'Semapur4', 48x48px
const unsigned char myBitmapSemapur4 [] PROGMEM = {
	0xff, 0xff, 0xf8, 0x3f, 0xff, 0xff, 0xff, 0xff, 0xf0, 0x1f, 0xff, 0xff, 0xff, 0xff, 0xf0, 0x1f, 
	0xff, 0xff, 0xff, 0xff, 0xf1, 0x1f, 0xff, 0xff, 0xff, 0xff, 0xf0, 0x1f, 0xff, 0xff, 0xff, 0xff, 
	0xf0, 0x1f, 0xff, 0xff, 0xff, 0xff, 0xf0, 0x1f, 0xff, 0xff, 0xff, 0xff, 0xf7, 0xff, 0xff, 0xff, 
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	0xff, 0xff, 0xff, 0xff, 0xff, 0xff, 0xff, 0xff, 0xff, 0xff, 0xff, 0xff, 0xff, 0xff, 0xff, 0xff
};
// 'Semapur3', 48x48px
const unsigned char myBitmapSemapur3 [] PROGMEM = {
	0xff, 0x7f, 0xff, 0xff, 0xff, 0xff, 0xfe, 0x3f, 0xff, 0xff, 0xff, 0xff, 0xfc, 0x1f, 0xff, 0xff, 
	0xff, 0xff, 0xf8, 0x0f, 0xff, 0xff, 0xff, 0xff, 0xf0, 0x87, 0xff, 0xff, 0xff, 0xff, 0xf0, 0x83, 
	0xff, 0xff, 0xff, 0xff, 0xf8, 0x08, 0xff, 0xff, 0xff, 0xff, 0xfc, 0x1c, 0xff, 0xff, 0xff, 0xff, 
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	0xff, 0xff, 0xff, 0xff, 0xff, 0xff, 0xff, 0xff, 0xff, 0xff, 0xff, 0xff, 0xff, 0xff, 0xff, 0xff
};
// 'Semapur2', 48x48px
const unsigned char myBitmapSemapur2 [] PROGMEM = {
	0xff, 0xff, 0xff, 0xff, 0xff, 0xff, 0xff, 0xff, 0xff, 0xff, 0xff, 0xff, 0xff, 0xff, 0xff, 0xff, 
	0xff, 0xff, 0xff, 0xff, 0xff, 0xff, 0xff, 0xff, 0xff, 0xff, 0xff, 0xff, 0xff, 0xff, 0xff, 0xff, 
	0xff, 0xff, 0xff, 0xff, 0xff, 0xff, 0xff, 0xff, 0xff, 0xff, 0xff, 0xff, 0xff, 0xff, 0xff, 0xff, 
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	0xff, 0xff, 0xff, 0xff, 0xff, 0xff, 0xff, 0xff, 0xff, 0xff, 0xff, 0xff, 0xff, 0xff, 0xff, 0xff
};
// 'Semapur1', 48x48px
const unsigned char myBitmapSemapur1 [] PROGMEM = {
	0xff, 0xff, 0xff, 0xff, 0xff, 0xff, 0xff, 0xff, 0xff, 0xff, 0xff, 0xff, 0xff, 0xff, 0xff, 0xff, 
	0xff, 0xff, 0xff, 0xff, 0xff, 0xff, 0xff, 0xff, 0xff, 0xff, 0xff, 0xff, 0xff, 0xff, 0xff, 0xff, 
	0xff, 0xff, 0xff, 0xff, 0xff, 0xff, 0xff, 0xff, 0xff, 0xff, 0xff, 0xff, 0xff, 0xff, 0xff, 0xff, 
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	0xff, 0xff, 0xff, 0xff, 0xff, 0xff, 0xff, 0xff, 0xff, 0xff, 0xff, 0xff, 0xff, 0xff, 0xff, 0xff
};

// Array of all bitmaps for convenience. (Total bytes used to store images in PROGMEM = 7904)
const unsigned char* hurufArray[26] = {
	myBitmapSemapur1,
	myBitmapSemapur2,
	myBitmapSemapur3,
	myBitmapSemapur4,
	myBitmapSemapur5,
	myBitmapSemapur6,
	myBitmapSemapur7,
	myBitmapSemapur8,
	myBitmapSemapur9,
	myBitmapSemapur10,
	myBitmapSemapur11,
	myBitmapSemapur12,
	myBitmapSemapur13,
	myBitmapSemapur14,
	myBitmapSemapur15,
	myBitmapSemapur16,
	myBitmapSemapur17,
	myBitmapSemapur18,
	myBitmapSemapur19,
	myBitmapSemapur20,
	myBitmapSemapur21,
	myBitmapSemapur22,
	myBitmapSemapur23,
	myBitmapSemapur24,
	myBitmapSemapur25,
	myBitmapSemapur26
};


//Morse
String morseCode[] = {
  ".-", "-...", "-.-.", "-..", ".", "..-.", "--.", "....", "..", ".---",
  "-.-", ".-..", "--", "-.", "---", ".--.", "--.-", ".-.", "...", "-",
  "..-", "...-", ".--", "-..-", "-.--", "--.."
};

String kosakata[] = {
  "rumah", "mobil", "sepeda", "kucing", "anjing", "meja", "kursi", "komputer", "telepon", "buku",
  "pohon", "jendela", "pintu", "roti", "susu", "air", "makan", "minum", "tidur", "belajar",
  "musik", "seni", "olahraga", "malam", "pagi", "siang", "kemarin", "besok", "bulan", "matahari",
  "bintang", "gurun", "hutan", "gunung", "laut", "pantai", "pulau", "kota", "desa", "negara",
  "sekolah", "rumah sakit", "restoran", "kantin", "taman", "hujan", "salju", "angin", "panas", "dingin",
  "warna", "merah", "biru", "kuning", "hijau", "hitam", "putih", "jalan", "jembatan", "bandara",
  "kacamata", "topi", "sepatu", "kemeja", "celana", "kemeja", "topi", "sepatu", "tas", "uang",
  "teman", "keluarga", "cinta", "senyum", "tawa", "mimpi", "kisah", "lagu", "berbicara", "menulis",
  "makanan", "minuman", "makan malam", "sarapan", "lunch", "kendaraan", "pesawat", "kereta", "bus", "kapal",
  // Tambahkan 150 kosakata berikut:
  "gitar", "piano", "drum", "mangga", "apel", "stroberi", "jeruk", "manggis", "sawit", "padi",
  "mangrove", "pantai", "gunung berapi", "sungai", "danau", "kucing hitam", "anjing laut", "burung hantu", "kumbang", "laba-laba",
  "kuda", "sapi", "kerbau", "kambing", "domba", "kuda nil", "jerapah", "buaya", "lintah", "ular",
  "katak", "ikan", "lumba-lumba", "penyu", "hiu", "kelinci", "hamster", "gerbil", "beruang", "singa",
  "gajah", "macan tutul", "serigala", "jerapah", "lalat", "lebah", "capung", "nyamuk", "kecoa", "semut",
  "gigabyte", "terabyte", "kilobyte", "megabyte", "teropong", "mikroskop", "teleskop", "kamera", "pensil", "pensil warna",
  "penghapus", "pensil mekanik", "penggaris", "pensil tinta", "kayu", "batu", "besi", "emas", "perak", "kaca",
  "kayu jati", "kayu pinus", "kayu mahoni", "kayu merbau", "kertas", "kertas tisu", "kertas jurnal", "kertas gambar", "papan tulis", "marker",
  "jam tangan", "kalung", "gelang", "anting-anting", "cincin", "topeng", "bola", "raket", "net", "kunci",
  "jendela", "pintu", "tirai", "lampu", "lampu lantai", "lampu meja", "kendaraan bermotor", "kendaraan listrik", "skateboard", "sepatu roda",
  "sepeda motor", "kuda putih", "layang-layang", "tentara", "pemadam kebakaran", "polisi", "penyelam", "penyanyi", "pelukis", "penulis",
  "aktor", "dokter", "insinyur", "petani", "pengacara", "penyair", "profesor", "sains", "matematika", "bahasa",
  "sejarah", "geografi", "ekonomi", "fisika", "kimia", "biologi", "budaya", "seni", "teknologi", "robot",
  "laser", "komunikasi", "internet", "sosial media", "aplikasi", "perangkat lunak", "perangkat keras", "ram", "prosesor", "papan induk",
  "gawai", "smartphone", "tablet", "laptop", "komputer desktop", "kamera digital", "printer", "monitor", "proyektor", "kulkas",
  "kompor", "oven", "mesin cuci", "pengering pakaian", "microwave", "blender", "mesin kopi", "panci", "sendok", "garpu",
  "pisau", "piring", "mangkuk", "gelas", "teko", "piring", "piring kue", "piring saji", "piring sup", "piring salad",
  "piring pasta", "piring penutup", "piring utama", "piring pembuka", "piring pencuci mulut", "sandwich", "pizza", "pasta", "nasi goreng", "sushi"
  // Anda dapat terus menambahkan lebih banyak lagi di sini
};
    

unsigned long previousMillis = 0;
const long interval = 100;

const uint8_t bitmap8[] = {0x00, 0x00, 0x00, 0x00, 0x00, 0x00, 0x00, 0x00, 0x00, 0x00, 0x00, 0x00, 0x00,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 0x00, 0x00};

int selectM = 1;
int SpeedMorse = 5;

String chanceWord = "";

//Morse End

int SOUND_PIN = 34;
int BUZZER = 27;

//Setup
void setup() {
  rtc.setTime(0, 0, 0, 19, 10, 2023);
  Wire.begin(21, 22, 400000);
  Serial.begin(115200);
  WiFi.begin(ssid, password);
  while ( WiFi.status() != WL_CONNECTED ) {
    delay ( 500 );
    Serial.print ( "." );
  }
  timeClient.begin();
  
  pinMode(14, OUTPUT);
  pinMode(SOUND_PIN, INPUT);
  pinMode(BUZZER, OUTPUT);
    
  btn.attachClick(clickFunc);
  btn2.attachClick(clickFunc2);
  //btn.attachDoubleClick(dblClickFunc);
  btn.attachDuringLongPress(duringLongPres);
  btn.attachLongPressStop(pressStopLong);
  btn.setDebounceMs(80);
  btn2.setDebounceMs(80);
  
  if(!display.begin(SSD1306_SWITCHCAPVCC, SCREEN_ADDRESS)) {
    Serial.println(F("Gagal menginisialisasi layar OLED"));
    for(;;);
  }
    
    digitalWrite(14, LOW);
    delay(100);
    digitalWrite(14, HIGH);
    delay(100);
    digitalWrite(14, LOW);

  display.display();
  delay(1000);
  display.clearDisplay();
  startLogo();
  delay(2000);
  startMenu();
  delay(500);
  selectOne();
}

//Main Menu

void startMenu() {
    display.clearDisplay();
    display.setTextColor(WHITE);
    display.setTextSize(1);
    display.setFont(NULL);
    display.setCursor(30, 10);
    display.println("DATE FINDER");
    display.setCursor(48, 27);
    display.println("CLOCK");
    display.setCursor(34, 45);
    display.println("NOTE MUSIC");
    display.display();
}

void startLogo() {
    display.clearDisplay();
    display.setTextColor(WHITE);
    display.setTextSize(1);
    display.setFont(NULL);
    display.setCursor(48, 20);
    display.println("RAIHAN");
    display.setCursor(45, 30);
    display.setTextSize(1);
    display.println("MUFIDAN");
    display.drawRect(0, 0, 128, 64, 1);
    display.display();
}

void selectOne() {
    startMenu();
    display.drawRect(25, 5, 75, 16, 1);
    display.display();
}

void selectTwo() {
    startMenu();
    display.drawRect(43, 22, 40, 16, 1);
    display.display();
}

void selectThree() {
    startMenu();
    display.drawRect(30, 40, 67, 16, 1);
    display.display();
}

//DateFinder

void startDateFind() {
    if(dayFind > 31 || dayFind < 1){
        dayFind = 1;
    }
    if(monthFind > 12 || monthFind < 1){
        monthFind = 1;
    }
    if(yearFind > 2099 || yearFind < 1901){
        yearFind = 1901;
    }
    display.clearDisplay();
    display.setTextColor(WHITE);
    display.setTextSize(2);
    display.setFont(NULL);
    display.setCursor(10, 24);
    display.println(dayFind);
    display.drawLine(35, 37, 35, 25, 1);
    display.setCursor(39, 24);
    display.println(monthFind);
    display.drawLine(64, 37, 64, 25, 1);
    display.setCursor(68, 24);
    display.println(yearFind);
    display.display();
}

void setupDay(){
    startDateFind();
    display.fillRoundRect(18, 15, 5, 5, 3, 1);
    display.display();
}

void setupMonth(){
    startDateFind();
    display.fillRoundRect(48, 15, 5, 5, 3, 1);
    display.display();
}

void setupYear(){
    startDateFind();
    display.fillRoundRect(88, 15, 5, 5, 3, 1);
    display.display();
}


void hasilFinder() {
    rtc.setTime(0, 0, 0, dayFind, monthFind, yearFind);
    String hasilDate = rtc.getTime("%w");
    String hariIndo = "Senin";
    switch(hasilDate.toInt()){
        case 0:
        hariIndo = "Minggu";
        break;
        case 1:
        hariIndo = "Senin";
        break;
        case 2:
        hariIndo = "Selasa";
        break;
        case 3:
        hariIndo = "Rabu";
        break;
        case 4:
        hariIndo = "Kamis";
        break;
        case 5:
        hariIndo = "Jum'at";
        break;
        case 6:
        hariIndo = "Sabtu";
        break;
    }
    display.clearDisplay();
    display.setTextColor(WHITE);
    display.setTextSize(1);
    display.setFont(NULL);
    display.setCursor(10, 30);
    display.println(hariIndo);
    display.drawRoundRect(0, 19, 128, 30, 12, 1);
    display.display();
}

//MorseFunc
String getMorseCode(char character) {
  if (character >= 'a' && character <= 'z') {
    return morseCode[character - 'a'];
  }
  return "\0"; // Handle other characters if needed
}

String getRandomWord() {
  int randomIndex = random(0, sizeof(kosakata) / sizeof(kosakata[0]));
  String randomWord = kosakata[randomIndex];
  return randomWord;
}

void menuMorse() {
    display.clearDisplay();
    display.setTextColor(WHITE);
    display.setTextSize(2);
    display.setFont(&Org_01);
    display.setCursor(33, 25);
    display.println("MULAI");
    display.setCursor(17, 43);
    display.setTextSize(2);
    display.println("SETTINGS");
    display.display();
}

void selectMenuMorseOne() {
    menuMorse();
    display.drawRoundRect(30, 14, 64, 16, 3, 1);//Mulai
    display.display();
}

void selectMenuMorseTwo() {
    menuMorse();
    display.drawRoundRect(14, 32, 100, 16, 3, 1);
    display.display();
}

void settingFast(){
    onPage = "setFast";
    if(SpeedMorse > 10){
        SpeedMorse = 1;
    }
    if(SpeedMorse < 1){
        SpeedMorse = 10;
    }
    //String OnView = SpeedMorse < 10 ? "0" + SpeedMorse : SpeedMorse;
    display.clearDisplay();
    display.setTextColor(WHITE);
    display.setTextSize(9);
    display.setFont(&Org_01);
    display.setCursor(0, 53);
    display.setTextWrap(0);
    display.setCursor(32, 53);
    display.println(SpeedMorse);
    display.setCursor(0, 10);
    display.setFont(NULL);
    display.setTextSize(1);
    display.setTextWrap(0);
    display.setCursor(31, 4);
    display.println("Morse Speed");
    display.display();
}

void startMorseGame(String oldRandom = "not0x") {
    onPage = "morseInGame";
    display.clearDisplay();
    display.setTextColor(WHITE);
    display.setTextSize(1);
    display.setFont(NULL);
    display.drawBitmap(30, 0, bitmap8, 64, 64, 1);
    display.display();
    
    int delayDotLong = SpeedMorse * 100;
    int delayLong = SpeedMorse > 2 ? 600 + (SpeedMorse * 10) : SpeedMorse * 300;
    int delayBetweenChar = SpeedMorse > 2 ? (SpeedMorse * 300 / 2) + SpeedMorse * 15 : SpeedMorse * 300;
    int delayFinish = delayDotLong + delayLong + delayBetweenChar;
    
  String randomWord = oldRandom == "not0x" ? getRandomWord() : oldRandom;
  int totalLength = 1;
  for (int i = 0; i < randomWord.length(); i++) {
    char character = randomWord[i];
    String morse = getMorseCode(character);
    
    for (int j = 0; j < morse.length(); j++) {
      if (morse[j] == '.') {
        // Play short sound on the buzzer
        digitalWrite(BUZZER, HIGH);
        delay(100);
        digitalWrite(BUZZER, LOW);
        delay(delayDotLong);
      } else if (morse[j] == '-') {
        // Play long sound on the buzzer
        digitalWrite(BUZZER, HIGH);
        delay(delayLong);
        digitalWrite(BUZZER, LOW);
        delay(delayDotLong);
      }
    }
    
    delay(delayBetweenChar); // Pause between characters
    totalLength++;
    
    if(totalLength >= randomWord.length()){
        delay(delayFinish);
        totalLength = 1;
        chanceWord = randomWord;
        akhirMorseView();
        onPage = "morseInGameDone";
    }
  }
}

void akhirMorseView() {
    onPage = "morseInGameDone";
    display.clearDisplay();
    display.setTextColor(WHITE);
    display.setTextSize(1);
    display.setFont(NULL);
    display.setCursor(45, 20);
    display.println("ULANGI");
    display.setCursor(27, 35);
    display.println("LIHAT JAWABAN");
    display.setCursor(85, 20);
    display.println(">>");
    display.setCursor(10, 35);
    display.println("<<");
    display.display();
}

void morseHasil(){
    display.clearDisplay();
    display.setTextColor(WHITE);
    display.setTextSize(1);
    display.setFont(NULL);
    display.setCursor(10, 30);
    display.println(chanceWord);
    display.drawRoundRect(0, 19, 128, 30, 12, 1);
    display.display();
}

//MorseEnd

void testSmp(){
    
    for(int i = 0; i <= 25; i++){
        display.clearDisplay();
        display.drawBitmap(40, 8, hurufArray[i], 48, 48, 1);
        display.display();
        delay(500);
        
        if(i >= 25){
            startMenu();
            delay(150);
            onPage = "menu";
            selectOne();
        }
    }
}

//ButtonFunc

void clickFunc(){
    Serial.println(onPage);
    if(onPage == "menu"){
        if(selectP < 6){
        selectP++;
        }else{
            selectP = 1;
        }
    }
    
    if(onPage == "setFast"){
        SpeedMorse++;
    }
    
    if(onPage == "morseGame"){
        if(selectM < 2){
        selectM++;
        }else{
            selectM = 1;
        }
    }
    
    if(onPage == "dateFind"){
        if(onsetup < 4){
            onsetup++;
        }
        else{
            startMenu();
            delay(150);
            onPage = "menu";
            selectOne();
        }
    }
    
    if(onPage == "clock"){
        startMenu();
        delay(150);
        onPage = "menu";
        selectOne();
    }
    
    if(onPage == "spectrum"){
        startMenu();
        delay(150);
        onPage = "menu";
        selectOne();
    }
    
    if(onPage == "morseInGameHasil"){
        startMenu();
        delay(150);
        onPage = "menu";
        selectOne();
    }
    
    if(onPage == "morseInGameDone"){
        morseHasil();
        delay(150);
        onPage = "morseInGameHasil";
        delay(150);
    }
    
    delay(100);
}

void clickFunc2(){
    Serial.println("Kepencet2");
    if(onPage == "dateFind"){
        if(onsetup == 1){
            dayFind--;
            delay(50);
        }
        if(onsetup == 2){
            monthFind--;
            delay(50);
        }
        if(onsetup == 3){
            yearFind--;
            delay(50);
        }
    }
    
    if(onPage == "setFast"){
        SpeedMorse--;
    }
    
    if(onPage == "morseInGameDone"){
        delay(150);
        startMorseGame(chanceWord);
        delay(150);
    }
    
    if(onPage == "morseInGameHasil"){
        startMorseGame();
        delay(150);
    }
    
    if(onPage == "morseGame"){
        if(selectM == 1){
            startMorseGame();
            delay (150);
            onPage == "morseInGame";
        }
        if(selectM == 2){
            settingFast();
            delay(150);
        }
    }
}

void pressStopLong(){
    
    if(onPage == "menu"){
        if(selectP == 1){
            startDateFind();
            onPage = "dateFind";
            onsetup = 1;
            digitalWrite(14, HIGH);
            delay(500);
        }
        if(selectP == 2){
            clockView();
            onPage = "clock";
            delay(250);
        }
        if(selectP == 3){
            spectrumView();
            onPage = "spectrum";
            delay(250);
        }
        if(selectP == 4){
            menuMorse();
            onPage = "morseGame";
            delay(250);
        }
        if(selectP == 5){
            testSmp();
            onPage = "semaphoreMenu";
            delay(250);
        }
        delay(150);
    }
    
    if(onPage == "setFast"){
        menuMorse();
        onPage = "morseGame";
        delay(250);
    }
    
    delay(100);
}

void duringLongPres(){
    if(onPage == "dateFind"){
        if(onsetup == 1){
            dayFind++;
            delay(100);
        }
        if(onsetup == 2){
            monthFind++;
            delay(100);
        }
        if(onsetup == 3){
            yearFind++;
            delay(100);
        }
    }
}

void duringLongPres2(){
    //null
}

//AllView

void clockView(){
    unsigned long rawTime = timeClient.getEpochTime() + 25200;
    
    if (rawTime != last_second){
    time_t tt = rawTime;
    
    int jam = hour(tt);
    String jamStr = jam < 10 ? "0" + String(jam) : String(jam);
    int menit = minute(tt);
    String menitStr = menit < 10 ? "0" + String(menit) : String(menit);
    
    String hari;
    switch (weekday(tt)){
    case 1 :
      hari = "MINGGU";
      break;
    case 2 :
      hari = "SENIN";
      break;
    case 3 :
      hari = "SELASA";
      break;
    case 4 :
      hari = "RABU";
      break;
    case 5 :
      hari = "KAMIS";
      break;
    case 6 :
      hari = "JUM'AT";
      break;
    case 7 :
      hari = "SABTU";
      break;
    }
    
    int tgl = day(tt);
    String tglStr = tgl < 10 ? "0" + String(tgl) : String(tgl);
    int bln = month(tt);
    String blnStr = bln < 10 ? "0" + String(bln) : String(bln);
    int thn = year(tt);
    String thnStr = String(thn);
    
    String tanggal = tglStr + "/" + blnStr + "/" + thnStr;
    
    display.clearDisplay();
    display.setTextColor(WHITE);
    display.setTextSize(4);
    display.setFont(&Org_01);
    display.setCursor(5, 27);
    display.println(jamStr);
    display.setCursor(5, 50);
    display.setTextSize(4);
    display.setFont(&Org_01);
    display.println(menitStr);
    display.drawRoundRect(0, 5, 54, 54, 3, 1);
    display.setFont(&Org_01);
    display.setCursor(57, 15);
    display.setTextSize(2);
    display.println(hari);
    display.setCursor(57, 25);
    display.setTextSize(1);
    display.println(tanggal);
    display.display();
    delay(100);
    last_second = rawTime;
    }
}

void spectrumView(){
    unsigned long currentMillis = millis();
    if (currentMillis - previousMillis >= interval) {
        previousMillis = currentMillis;
        for (int i = 0; i < samples; i++) {
            vReal[i] = analogRead(SOUND_PIN);
            vImag[i] = 0;
        }
        FFT = arduinoFFT(vReal, vImag, samples, sampling);
        FFT.Windowing(FFT_WIN_TYP_HAMMING, FFT_FORWARD);
        FFT.Compute(FFT_FORWARD);
        FFT.ComplexToMagnitude();
        display.clearDisplay();
        for (int i = 0; i < samples / 2; i++) {
            int barHeight = map(vReal[i], 0, 512, 0, SCREEN_HEIGHT - 1);
            display.drawFastVLine(i * 2, SCREEN_HEIGHT - barHeight, barHeight, SSD1306_WHITE);
        }
        display.display();
    }
}

void startMenuTwo(){
    display.clearDisplay();
    display.setTextColor(WHITE);
    display.setTextSize(1);
    display.setFont(NULL);
    display.setCursor(50, 10);
    display.println("MORSE");
    display.setCursor(36, 25);
    display.println("SEMAPHORE");
    display.setCursor(44, 40);
    display.println("COMSOON");
    display.display();
}

void selectOneTwo(){
    startMenuTwo();
    display.drawRoundRect(47, 8, 35, 11, 3, 1);//Morse
    display.display();
}

void selectTwoTwo(){
    startMenuTwo();
    display.drawRoundRect(33, 23, 59, 11, 3, 1);//Semapur
    display.display();
}

void selectThreeTwo(){
    startMenuTwo();
    display.drawRoundRect(41, 38, 47, 11, 3, 1);//ComingSoon
    display.display();
}

//Loop

void loop() {
    btn.tick();
    btn2.tick();
    timeClient.update();
    if(onPage == "menu"){
        if(selectP == 1){
            selectOne();
        }
        if(selectP == 2){
            selectTwo();
        }
        if(selectP == 3){
            selectThree();
        }
        if(selectP == 4){
            selectOneTwo();
        }
        if(selectP == 5){
            selectTwoTwo();
        }
        if(selectP == 6){
            selectThreeTwo();
        }
    }
    
    if(onPage == "dateFind"){
        
        if(onsetup == 1){
            setupDay();
        }
        
        if(onsetup == 2){
            setupMonth();
        }
        
        if(onsetup == 3){
            setupYear();
        }
        
        if(onsetup == 4){
            hasilFinder();
            digitalWrite(14, LOW);
        }
    }
    
    if(onPage == "setFast"){
        settingFast();
    }
    
    if(onPage == "clock"){
        clockView();
    }
    
    if(onPage == "spectrum"){
        spectrumView();
    }
    
    if(onPage == "morseGame"){
        if(selectM == 1){
            selectMenuMorseOne();
        }
        if(selectM == 2){
            selectMenuMorseTwo();
        }
    }
}
